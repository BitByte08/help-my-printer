## yocto/conf/bblayers.conf
```bitbake
LCONF_VERSION = "7"

BBPATH = "${TOPDIR}"
BBFILES ?= ""

BBLAYERS ?= " \
  /work/layers/openembedded-core/meta \
  /work/layers/meta-yocto/meta-poky \
  /work/layers/meta-openembedded/meta-oe \
  /work/layers/meta-raspberrypi \
  /repo/yocto/meta-helpmyprinter \
  "
```

## yocto/meta-helpmyprinter/conf/layer.conf
```bitbake
BBPATH .= ":${LAYERDIR}"

BBFILES += "${LAYERDIR}/recipes-*/*/*.bb \
            ${LAYERDIR}/recipes-*/*/*.bbappend"

BBFILE_COLLECTIONS += "helpmyprinter"
BBFILE_PATTERN_helpmyprinter = "^${LAYERDIR}/"
BBFILE_PRIORITY_helpmyprinter = "10"

LAYERDEPENDS_helpmyprinter = "core openembedded-layer"
LAYERSERIES_COMPAT_helpmyprinter = "wrynose"
```
